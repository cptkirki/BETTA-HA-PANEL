## sdkconfig.defaults
```kconfig
# Core behavior defaults for development
CONFIG_LOG_DEFAULT_LEVEL_INFO=y
CONFIG_FREERTOS_HZ=1000
CONFIG_ESP_TASK_WDT_TIMEOUT_S=10
CONFIG_ESP_MAIN_TASK_STACK_SIZE=6144
CONFIG_ESPTOOLPY_FLASHSIZE_32MB=y

# Use custom partition table with LittleFS storage partition
# CONFIG_PARTITION_TABLE_SINGLE_APP is not set
CONFIG_PARTITION_TABLE_CUSTOM=y
CONFIG_PARTITION_TABLE_CUSTOM_FILENAME="partitions.csv"
CONFIG_PARTITION_TABLE_FILENAME="partitions.csv"

# ESP-Hosted over SDIO (ESP32-P4 host + ESP32-C6 coprocessor)
CONFIG_ESP_WIFI_REMOTE_ENABLED=y
CONFIG_ESP_WIFI_REMOTE_LIBRARY_HOSTED=y
CONFIG_SLAVE_IDF_TARGET_ESP32C6=y

CONFIG_ESP_HOSTED_SDIO_HOST_INTERFACE=y
# CONFIG_ESP_HOSTED_SPI_HOST_INTERFACE is not set
# CONFIG_ESP_HOSTED_SPI_HD_HOST_INTERFACE is not set
# CONFIG_ESP_HOSTED_UART_HOST_INTERFACE is not set
CONFIG_ESP_HOSTED_P4_DEV_BOARD_NONE=y
# CONFIG_ESP_HOSTED_P4_DEV_BOARD_FUNC_BOARD is not set
CONFIG_ESP_HOSTED_SDIO_SLOT_1=y
CONFIG_ESP_HOSTED_SDIO_4_BIT_BUS=y
CONFIG_ESP_HOSTED_SDIO_CLOCK_FREQ_KHZ=40000
CONFIG_ESP_SDIO_CLOCK_FREQ_KHZ=40000
CONFIG_ESP_HOSTED_SDIO_RESET_DELAY_MS=1500
# CONFIG_ESP_HOSTED_SDIO_OPTIMIZATION_RX_MAX_SIZE is not set
CONFIG_ESP_HOSTED_SDIO_OPTIMIZATION_RX_STREAMING_MODE=y
# CONFIG_ESP_HOSTED_SDIO_OPTIMIZATION_RX_NONE is not set

# User provided ESP-Hosted SDIO wiring
CONFIG_ESP_HOSTED_PRIV_SDIO_PIN_CLK_SLOT_1=18
CONFIG_ESP_HOSTED_PRIV_SDIO_PIN_CMD_SLOT_1=19
CONFIG_ESP_HOSTED_PRIV_SDIO_PIN_D0_SLOT_1=14
CONFIG_ESP_HOSTED_PRIV_SDIO_PIN_D1_4BIT_BUS_SLOT_1=15
CONFIG_ESP_HOSTED_PRIV_SDIO_PIN_D2_4BIT_BUS_SLOT_1=16
CONFIG_ESP_HOSTED_PRIV_SDIO_PIN_D3_4BIT_BUS_SLOT_1=17
CONFIG_ESP_HOSTED_SDIO_GPIO_RESET_SLAVE=54
CONFIG_ESP_HOSTED_SDIO_RESET_ACTIVE_HIGH=y
# CONFIG_ESP_HOSTED_SDIO_RESET_ACTIVE_LOW is not set
# CONFIG_ESP_HOSTED_RESET_GPIO_ACTIVE_LOW is not set

# Recommended Wi-Fi remote tuning for P4 + C6
CONFIG_WIFI_RMT_STATIC_RX_BUFFER_NUM=16
CONFIG_WIFI_RMT_DYNAMIC_RX_BUFFER_NUM=64
CONFIG_WIFI_RMT_DYNAMIC_TX_BUFFER_NUM=64
CONFIG_WIFI_RMT_AMPDU_TX_ENABLED=y
CONFIG_WIFI_RMT_TX_BA_WIN=32
CONFIG_WIFI_RMT_AMPDU_RX_ENABLED=y
CONFIG_WIFI_RMT_RX_BA_WIN=32

# Recommended LWIP mailbox/window sizing for Hosted Wi-Fi use-cases
CONFIG_LWIP_TCPIP_RECVMBOX_SIZE=32
CONFIG_LWIP_TCP_RECVMBOX_SIZE=32
CONFIG_LWIP_UDP_RECVMBOX_SIZE=32
CONFIG_LWIP_MAX_SOCKETS=16
CONFIG_LWIP_TCP_MSS=1200
CONFIG_LWIP_TCP_SND_BUF_DEFAULT=16384
CONFIG_LWIP_TCP_WND_DEFAULT=16384
CONFIG_LWIP_TCP_SACK_OUT=y

# Keep station-only footprint for MVP
CONFIG_ESP_WIFI_SOFTAP_SUPPORT=n

# Internal-memory pressure tuning:
# esp_hosted SDIO RX + mbedTLS AES DMA require MALLOC_CAP_INTERNAL|DMA.
CONFIG_SPIRAM_MALLOC_ALWAYSINTERNAL=8192
CONFIG_SPIRAM_MALLOC_RESERVE_INTERNAL=65536
CONFIG_ESP_HOSTED_DFLT_TASK_FROM_SPIRAM=y

# Reduce peak TLS memory to avoid DMA descriptor allocation failures
CONFIG_MBEDTLS_DYNAMIC_BUFFER=y
CONFIG_MBEDTLS_SSL_IN_CONTENT_LEN=4096
CONFIG_MBEDTLS_SSL_OUT_CONTENT_LEN=2048
CONFIG_MBEDTLS_EXTERNAL_MEM_ALLOC=y
# CONFIG_MBEDTLS_INTERNAL_MEM_ALLOC is not set
CONFIG_MBEDTLS_DYNAMIC_FREE_CONFIG_DATA=y
# CONFIG_MBEDTLS_SSL_KEEP_PEER_CERTIFICATE is not set
CONFIG_ESP_WS_CLIENT_SEPARATE_TX_LOCK=y

# App defaults
CONFIG_APP_WIFI_DISABLE_POWER_SAVE=y
CONFIG_APP_HA_FETCH_INITIAL_STATES=y
CONFIG_APP_HA_SUBSCRIBE_STATE_CHANGED=y
CONFIG_APP_HA_PING_INTERVAL_MS=30000

# Keep hosted C6 out of Wi-Fi 6 TWT power-save behavior
# CONFIG_ESP_HOSTED_ENABLE_ITWT is not set

# Disable ESP-Hosted host-side power-save/deep-sleep. The P4 host has no wake GPIO wired.
# CONFIG_ESP_HOSTED_HOST_POWER_SAVE_ENABLED is not set
# CONFIG_ESP_HOSTED_HOST_DEEP_SLEEP_ALLOWED is not set

# Keep remote station PM fully disabled for long-lived websocket links
# CONFIG_WIFI_RMT_STA_DISCONNECTED_PM_ENABLE is not set
# CONFIG_ESP_WIFI_STA_DISCONNECTED_PM_ENABLE is not set

# Runtime tiny_ttf disabled: icons are provided by generated static LVGL font C-array.
# CONFIG_LV_USE_TINY_TTF is not set
CONFIG_LV_USE_VECTOR_GRAPHIC=y
CONFIG_LV_USE_FLOAT=y
CONFIG_LV_USE_MATRIX=y
CONFIG_LV_USE_THORVG=y
CONFIG_LV_USE_THORVG_INTERNAL=y
CONFIG_LV_USE_LOTTIE=y

# Display/LVGL performance profile for ESP32-P4 + DSI
CONFIG_LVGL_PORT_ENABLE_PPA=y
CONFIG_BSP_LCD_DPI_BUFFER_NUMS=2
CONFIG_BSP_DISPLAY_LVGL_AVOID_TEAR=y
# CONFIG_BSP_DISPLAY_LVGL_FULL_REFRESH is not set
CONFIG_BSP_DISPLAY_LVGL_DIRECT_MODE=y
CONFIG_LV_DEF_REFR_PERIOD=16

# Heating tile typography
CONFIG_LV_FONT_MONTSERRAT_34=y
CONFIG_ESP_DEFAULT_CPU_FREQ_MHZ_360=y
CONFIG_ESP_DEFAULT_CPU_FREQ_MHZ=360
```

## src/main/Kconfig.projbuild
```kconfig
menu "Example Configuration"

menu "Wi-Fi Station"

config APP_WIFI_SSID
    string "Wi-Fi SSID"
    default "YOUR_WIFI_SSID"
    help
        SSID of your access point.
        ESP32-C6 supports 2.4 GHz Wi-Fi.

config APP_WIFI_PASSWORD
    string "Wi-Fi Password"
    default "YOUR_WIFI_PASSWORD"
    help
        Password for your access point.
        Set empty only for open networks.

config APP_WIFI_WAIT_FOR_IP
    bool "Wait for IP before continuing boot"
    default y
    help
        If enabled, startup waits until station got IP or timeout.

config APP_WIFI_CONNECT_TIMEOUT_MS
    int "Wi-Fi connect timeout (ms)"
    range 1000 120000
    default 15000
    help
        Maximum time to wait for IP when wait-for-IP is enabled.

config APP_WIFI_MAX_RETRIES
    int "Wi-Fi max reconnect retries"
    range 1 100
    default 8
    help
        Number of reconnect attempts after disconnect.

config APP_WIFI_DISABLE_POWER_SAVE
    bool "Disable Wi-Fi power save (WIFI_PS_NONE)"
    default y
    help
        Forces Wi-Fi modem power-save off on the hosted C6 via esp_wifi_set_ps(WIFI_PS_NONE).
        Recommended for maximum websocket stability.

endmenu

menu "ESP-Hosted"

config APP_HOSTED_AUTO_UPDATE_C6_FW
    bool "Auto-update C6 firmware on version mismatch"
    default y
    depends on ESP_HOSTED_ENABLED
    help
        If enabled, the host compares the running ESP32-C6 firmware version
        with the ESP-Hosted host stack version and performs a slave OTA update
        when they differ. After successful OTA, the host reboots to resync.

endmenu

menu "Home Assistant"

config APP_HA_WS_URL
    string "HA WebSocket URL"
    default "YOUR_HA_WS_URL"
    help
        Example: wss://homeassistant.local:8123/api/websocket

config APP_HA_ACCESS_TOKEN
    string "HA Long-lived Access Token"
    default "YOUR_HA_ACCESS_TOKEN"
    help
        Long-lived access token used for Home Assistant authentication.

config APP_HA_FETCH_INITIAL_STATES
    bool "Fetch initial states after auth_ok"
    default y
    help
        When enabled, the device sends Home Assistant get_states right after
        websocket authentication. This can be memory-intensive on constrained
        links; keep disabled for maximum runtime stability.

config APP_HA_SUBSCRIBE_STATE_CHANGED
    bool "Subscribe to HA state_changed event stream"
    default y
    help
        Enables global Home Assistant state_changed subscription.
        This can produce high event volume; keep disabled while focusing
        on transport stability, then enable once stable.

config APP_HA_PING_INTERVAL_MS
    int "HA ping interval (ms)"
    range 5000 120000
    default 8000
    help
        Periodic Home Assistant websocket "ping" message interval.
        Keeps the application session active even during long idle periods.

endmenu

menu "Time"

config APP_NTP_SERVER
    string "NTP server"
    default "pool.ntp.org"
    help
        NTP server used for time synchronization.

config APP_TIME_TZ
    string "Timezone (POSIX TZ)"
    default "CET-1CEST,M3.5.0/2,M10.5.0/3"
    help
        POSIX timezone string used for localtime conversion.
        Default is Europe/Berlin with automatic DST switching.

endmenu

endmenu
```
